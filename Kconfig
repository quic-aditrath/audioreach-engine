## Kconfig
```kconfig
mainmenu "AudioReach Engine $(MAJOR_VERSION).$(MINOR_VERSION)-$(PATCHLEVEL) Configuration"
source arch/Kconfig
source modules/Kconfig
source fwk/Kconfig
source fwk/spf/modules/Kconfig
```

## arch/hexagon/Kconfig
```kconfig
menuconfig ARCH_HEXAGON
        bool "Hexagon Architecture"
	help
          Say yes if you need Hexagon Architecture support

if ARCH_HEXAGON

config HEXAGON_TOOLS_ROOT
	string "Path to Hexagon llvm tools"
	help
	 Absolute Path to Hexagon tools

config HEXAGON_SDK_ROOT
	string "Path to Hexagon SDK root"
	help
	 Absolute Path to Hexagon SDK root

config DISABLE_PLATFORM
	bool "Disable compiling platform."
	default y
	help
	Select y to disable platform compilation,
	say n to compile platform.

config COMPILE_POSAL
	bool "Compile POSAL source files."
	default n
	help
	Select y to compile posal source files,
	say n to skip posal source files compilation.

endif
```

## fwk/Kconfig
```kconfig
menu "Signal Processing Framework"
config SPF
	bool

config SPF_AS_STATIC_LIB
        bool "Compile SPF Library as Static Library"
	depends on ARCH_HEXAGON
	select SPF
        default n
	help
	 Select y if you want to compile SPF as Static Library,
	 else it will compiled as Shared Library.
	 By default its built as Shared Library.

config SPF_DEBUG
        bool "Enable SPF DEBUG Features"
        default n

endmenu
```

## fwk/platform/modules/Kconfig
```kconfig
menu "Platform Modules"

config ALSA_DEVICE_SINK
        tristate "Enable ALSA_DEVICE_SINK Library"
        default y

endmenu
```

## fwk/spf/containers/Kconfig
```kconfig
menu "Containers"

config WR_SH_MEM_EP
        bool "Enable Write Share Memory Endpoint"
        default y

config SPECIAL_TOPOLOGY
        bool "Enable Special Topology"
        default y
        help
            Enable compilation of special topology components (spl_topo).

endmenu
```

## fwk/spf/modules/Kconfig
```kconfig
menu "Signal Processing Framework Modules"

config DATA_LOGGING
        tristate "Enable DATA_LOGGING Library"
        default y

config LATENCY
        tristate "Enable LATENCY Library"
        default y

config SYNC
        tristate "Enable SYNC Library"
        default y

config SPR
        tristate "Enable SPR Library"
        default y

config SPLITTER
        tristate "Enable SPLITTER Library"
        default y

config DATA_MARKER
        tristate "Enable DATA_MARKER Library"
        default y

config PRIORITY_SYNC
        tristate "Enable DATA_MARKER Library"
        default y

config MUX_DEMUX
        tristate "Enable DATA_MARKER Library"
        default y

config SISO_RAT
        tristate "Enable DATA_MARKER Library"
        default y

config SH_MEM_PULL_MODE
        tristate "Enable DATA_MARKER Library"
        default y

config SH_MEM_PUSH_MODE
        tristate "Enable DATA_MARKER Library"
        default y

endmenu
```

## modules/Kconfig
```kconfig
menu "Modules"
config MODULES
	bool
	default y

config MODULES_DEBUG
        bool "Enable MODULUES DEBUG Features"
        default y
	help
	 Select y to enable debug symbols in modules,
	 say n to strip debug symbols

config ENCODER
        tristate "Enable Example Encoder Library"
        default y

config ECHO_CANCELLATION
        tristate "Enable ECHO Cancellation Library"
        default y

config GAIN
        tristate "Enable GAIN Library"
        default y
endmenu
```
